/*
 * SAMSUNG EXYNOS7885 SoC device tree source
 *
 * Copyright (c) 2018 Samsung Electronics Co., Ltd.
 *		http://www.samsung.com
 *
 * This program is free software; you can redistribute it and/or modify
 * it under the terms of the GNU General Public License version 2 as
 * published by the Free Software Foundation.
*/

&mali {
interactive_info = <260000 94 0>;
       gpu_dvfs_table_size = <13 8>; /*<row col>*/
       /*  8 columns           freq    down   up  stay  mif    little  middle   big  */
       gpu_dvfs_table = <
                          /* 910000    78  100   9  2093000 1456000       0 1820000 */
                          /* 858000    78  100   9  2093000 1456000       0 1820000 */
                          /* 806000    78  100   9  2093000 1456000       0 1820000 */
                          754000    70   90   9  2093000 1456000       0 1820000
                          702000    72   90   9  2093000 1456000       0 1820000
                          676000    74   92   5  2093000 1456000       0 2080000
                          650000    74   92   5  2093000 1456000       0 2080000
                          598000    75   92   5  2093000 1456000       0 2080000
                          572000    75   92   5  1794000       0       0       0
                          433000    76   90   2  1352000       0       0       0
                          377000    78   90   2  1352000       0       0       0
                          325000    80   88   2  1014000       0       0       0
                          260000    80   88   2   676000       0       0       0
                          200000    82   85   2   676000       0       0       0
                          156000    82   85   2   676000       0       0       0
                          100000     0   85   1   676000       0       0       0 >;
       gpu_cl_pmqos_table_size = <13 5>;
       gpu_cl_pmqos_table = <
 /* 910000 2093000 1456000       0 1820000 */
 /* 858000 2093000 1456000       0 1820000 */
 /* 806000 2093000 1456000       0 1820000 */
 754000 2093000 1456000       0 1820000
 702000 2093000 1456000       0 1820000
 676000 2093000 1456000       0 2080000
 650000 2093000 1456000       0 2080000
 598000 2093000 1456000       0 2080000
 572000 1794000       0       0       0
 433000 1352000       0       0       0
 377000 1352000       0       0       0
 325000 1014000       0       0       0
 260000  676000       0       0       0
 200000  676000       0       0       0
 156000  676000       0       0       0
 100000  676000       0       0       0 >;
       gpu_heavy_compute_cpu0_min_clock = <1456000>;
       gpu_heavy_compute_vk_cpu0_min_clock = <1456000>;
       gpu_weight_table_idx_0 = <0>;
       gpu_weight_table_idx_1 = <0>;
    gpu_max_clock = <754000>;
    gpu_max_clock_limit = <754000>;
        gpu_min_clock = <100000>;
        gpu_dvfs_start_clock = <260000>;
        gpu_dvfs_bl_config_clock = <156000>;
};
