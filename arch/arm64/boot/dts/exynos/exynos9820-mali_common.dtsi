/ {
	/* mali */
    mali: mali@18500000 {
        compatible = "arm,mali";
        reg = <0x0 0x18500000 0x5000>;
        interrupts = <0 288 0>,
                     <0 287 0>,
                     <0 289 0>;
        interrupt-names = "JOB", "MMU", "GPU";
        g3d_cmu_cal_id = <ACPM_DVFS_G3D>;
        samsung,power-domain = <&pd_embedded_g3d>;
        g3d_genpd_name = "pd-embedded_g3d"; /*KC: pg-g3d, LT,MK: pd-embedded_g3d*/
        #cooling-cells = <2>; /* min followed by max */
		governor = "interactive";
		interactive_info = <260000 94 0>;
        #include "exynos9820-mali_tables.dtsi"
		gpu_sustainable_info = <433000 95 949000 1690000 520000>;
		gpu_pmqos_cpu_cluster_num = <3>;
		gpu_pmu_status_reg_offset = <0x2104>;
		gpu_pmu_status_local_pwr_mask = <0x1>; /*0x1 << 0*/
		gpu_dvfs_start_clock = <100000>;
		gpu_dvfs_bl_config_clock = <100000>;
		gpu_default_voltage = <537500>;
		gpu_cold_minimum_vol = <0>;
		gpu_voltage_offset_margin = <37500>;
		gpu_tmu_control = <1>;
		gpu_temp_throttling_level_num = <1>;
		gpu_temp_throttling = <650000>;
		gpu_power_coeff = <625>;
		gpu_dvfs_time_interval = <5>; /*1 tick : 10ms*/
		gpu_default_wakeup_lock = <1>;
		gpu_dynamic_abb = <0>;
		gpu_early_clk_gating = <0>;
		gpu_dvs = <0>;
		gpu_inter_frame_pm = <0>;
		gpu_perf_gathering = <0>;
		gpu_runtime_pm_delay_time = <50>;
		gpu_dvfs_polling_time = <30>;
		gpu_pmqos_int_disable = <1>;
		gpu_pmqos_mif_max_clock = <1794000>;
		gpu_pmqos_mif_max_clock_base = <650000>;
		gpu_cl_dvfs_start_base = <100000>;
		gpu_debug_level = <1>; /*DEBUG(1) INFO(2) WARNING(3) ERROR(4)*/
		gpu_trace_level = <8>; /*TRACE_ALL*/
		gpu_mo_min_clock = <100000>;
		gpu_boost_gpu_min_lock = <0>;
		gpu_boost_egl_min_lock = <1144000>;
		gpu_vk_boost_max_lock = <650000>;
		gpu_vk_boost_mif_min_lock = <676000>;
		gpu_bts_support = <1>;
		gpu_asv_cali_lock_val = <0>; /*Should check this value when MALI_ASV_CALIBRATION_SUPPORT is enabled*/
		gpu_set_pmu_duration_reg = <0>; /* only for KC for now*/
		gpu_set_pmu_duration_val = <0>; /* only for KC for now*/
		gpu_ess_id_type = <ESS_FLAG_G3D>; /* for dbg snapshot */
	 };
};
