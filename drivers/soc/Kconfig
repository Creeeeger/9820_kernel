## drivers/soc/Kconfig
```kconfig
menu "SOC (System On Chip) specific Drivers"

source "drivers/soc/bcm/Kconfig"
source "drivers/soc/fsl/Kconfig"
source "drivers/soc/renesas/Kconfig"
source "drivers/soc/samsung/Kconfig"

endmenu
```
